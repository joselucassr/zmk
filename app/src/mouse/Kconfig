## app/src/mouse/Kconfig
```kconfig
# Copyright (c) 2023 The ZMK Contributors
# SPDX-License-Identifier: MIT

menuconfig ZMK_MOUSE
    bool "Mouse Emulation"
    select INPUT
    select INPUT_THREAD_PRIORITY_OVERRIDE
    select USB_COMPOSITE_DEVICE if ZMK_USB

menuconfig ZMK_MOUSE_PS2
	bool "Enable PS/2 mouse support"

if ZMK_MOUSE

if ZMK_USB

config USB_HID_DEVICE_COUNT
    default 2

endif

endif # ZMK_MOUSE
```
